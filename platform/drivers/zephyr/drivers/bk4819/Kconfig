## platform/drivers/zephyr/drivers/bk4819/Kconfig
```kconfig
config BK4819
    bool "BK4819 radio transceiver driver"
    depends on GPIO
    help
      Enable driver for Beken BK4819 radio transceiver chip.

if BK4819

config BK4819_INIT_PRIORITY
    int "BK4819 initialization priority"
    default 80
    help
      System initialization priority for BK4819 driver.

config BK4819_LOG_LEVEL
    int "BK4819 log level"
    default 3
    range 0 4
    help
      Log level for BK4819 driver.

endif # BK4819
```

## platform/drivers/zephyr/dts/bindings/bk4819/beken,bk4819.yaml
```yaml
description: Beken BK4819 Radio Transceiver

compatible: "beken,bk4819"

include: [base.yaml]

properties:
  clk-gpios:
    type: phandle-array
    required: true
    description: GPIO pin for SPI clock

  dat-gpios:
    type: phandle-array
    required: true
    description: GPIO pin for SPI data

  cs-gpios:
    type: phandle-array
    required: true
    description: GPIO pin for chip select

  mic-spk-en-gpios:
    type: phandle-array
    required: false
    description: GPIO pin for mic/speaker enable
```
